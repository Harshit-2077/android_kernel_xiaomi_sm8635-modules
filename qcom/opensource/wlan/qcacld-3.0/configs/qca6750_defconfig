## qcom/opensource/wlan/qcacld-3.0/configs/qca6750_defconfig
```kconfig
CONFIG_CNSS_QCA6750 := y
CONFIG_FEATURE_MONITOR_MODE_SUPPORT := y
CONFIG_FEATURE_FRAME_INJECTION_SUPPORT := y
$(warning "### DBG CONFIG_CNSS_QCA6750")
include $(WLAN_ROOT)/configs/default_defconfig
```
